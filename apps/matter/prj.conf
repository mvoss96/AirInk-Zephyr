## CMakeLists.txt
```
#
# Copyright (c) 2025 Nordic Semiconductor ASA
#
# SPDX-License-Identifier: LicenseRef-Nordic-5-Clause
#

cmake_minimum_required(VERSION 3.20.0)

set(AIRINK_ROOT ${CMAKE_CURRENT_SOURCE_DIR}/../..)

# The custom solomon,ssd1683 binding lives in <repo>/dts/bindings. Zephyr only looks under the
# application directory, which is this one -- point it at the repo root, or the e-paper node's
# width/height properties silently do not exist.
list(APPEND DTS_ROOT ${AIRINK_ROOT})

# The board's drivers, shared with the standalone firmware. Merged after prj.conf, so it holds
# board facts only -- see the file's header.
list(APPEND EXTRA_CONF_FILE ${AIRINK_ROOT}/conf/airink_hw.conf)

# conf/release.conf turns the logging off (worth ~7 uA). It is opt-in on the command line rather
# than a switch here, because EXTRA_CONF_FILE has to be set before find_package(Zephyr), and
# zephyr_get() -- the only thing that could read a sysbuild -D -- does not exist until after it:
#
#   west build -b promicro_nrf52840/nrf52840 apps/matter -d <dir> \
#       -- -Dmatter_EXTRA_CONF_FILE=<abs>/conf/release.conf
#
# The `matter_` prefix is how sysbuild routes a variable to this image rather than to itself; a bare
# -DAIRINK_POWER=y would land in the sysbuild cache and never be forwarded. See that file's header.

# The firmware version -- one file, <repo>/VERSION, for both apps and the panel. Must precede
# find_package(Zephyr): that is what loads version.cmake.
include(${AIRINK_ROOT}/cmake/airink_version.cmake)

find_package(Zephyr HINTS $ENV{ZEPHYR_BASE})

project(airink-matter)

# Enable GNU STD support.
include(${ZEPHYR_CONNECTEDHOMEIP_MODULE_DIR}/config/nrfconnect/app/enable-gnu-std.cmake)

# NORDIC SDK APP START

# Include all source files that are located in the Matter common directory.
include(${ZEPHYR_NRF_MODULE_DIR}/samples/matter/common/cmake/source_common.cmake)

# Include Data Model utils
include(${ZEPHYR_NRF_MODULE_DIR}/samples/matter/common/cmake/data_model.cmake)

include(${ZEPHYR_NRF_MODULE_DIR}/samples/matter/common/cmake/zap_helpers.cmake)
ncs_get_zap_parent_dir(ZAP_PARENT_DIR)

include(${AIRINK_ROOT}/cmake/airink_sources.cmake)

target_include_directories(app PRIVATE
  src
  ${ZAP_PARENT_DIR}
  ${AIRINK_INCLUDE_DIR}
)

# This build's own main(): it brings Matter up and then hands the device to app::run(), which runs
# on a thread of its own alongside the CHIP event loop and OpenThread.
target_sources(app PRIVATE
  src/app_task.cpp
  src/main.cpp
)

# The device itself -- the same sources the standalone firmware builds, minus its main().
target_sources(app PRIVATE
  ${AIRINK_DEVICE_SOURCES}
  ${AIRINK_LOOP_SOURCES}
)

ncs_configure_data_model()
# NORDIC SDK APP END
```

## Kconfig.sysbuild
```
#
# Copyright (c) 2025 Nordic Semiconductor ASA
#
# SPDX-License-Identifier: LicenseRef-Nordic-5-Clause
#

# The sample this is derived from defaulted the bootloader to MCUboot and turned on factory-data
# generation, DFU multi-image packaging and a network-core image -- all of it for boards we do not
# build (nRF53/nRF54) or for a boot flow we deliberately do not use. AirInk is a single-core
# nRF52840 booting a plain image from the Adafruit UF2 bootloader. The switches that matter live
# in sysbuild.conf; everything else takes the upstream default.

source "share/sysbuild/Kconfig"
```

## prj.conf
```kconfig
#
# Copyright (c) 2025 Nordic Semiconductor ASA
#
# SPDX-License-Identifier: LicenseRef-Nordic-5-Clause
#

# Enable CHIP
CONFIG_CHIP=y
CONFIG_CHIP_PROJECT_CONFIG="src/chip_project_config.h"

# Configure ZAP file name
CONFIG_NCS_SAMPLE_MATTER_ZAP_FILE_PATH="${APPLICATION_CONFIG_DIR}/src/default_zap/airink.zap"

# Device identity -- what a controller shows in its UI (Basic Information cluster). Left
# unset, every one of these falls back to a sample/test default: product name
# "Matter Temperature Sensor", hardware version "prerelease", serial "11223344556677889900".
# The serial is the same on every board we flash; per-device serials would need factory
# data, which we deliberately dropped (see CHIP_FACTORY_DATA_NONE below).
CONFIG_CHIP_DEVICE_VENDOR_NAME="AirInk"
CONFIG_CHIP_DEVICE_PRODUCT_NAME="AirInk CO2 Monitor"
CONFIG_CHIP_DEVICE_HARDWARE_VERSION=1
CONFIG_CHIP_DEVICE_HARDWARE_VERSION_STRING="rev A"
CONFIG_CHIP_DEVICE_SERIAL_NUMBER="AIRINK-0001"
# The software version comes from the VERSION file (the Kconfig is hidden once APPVERSION
# is set), not from here.

# Based on https://github.com/project-chip/connectedhomeip/blob/482e6fd03196a6de45465a90003947ef4b86e0b1/docs/examples/discussion/PID_allocation_for_example_apps.md)
# 0x8000 (32768), to match the example provider's DAC (FFF1-8000). Was 32781 (0x800D).
CONFIG_CHIP_DEVICE_PRODUCT_ID=32768
CONFIG_STD_CPP17=y

# Enable Matter pairing automatically on application start.
CONFIG_CHIP_ENABLE_PAIRING_AUTOSTART=y

# Enable Matter extended announcement and increase duration to 1 hour.
CONFIG_CHIP_BLE_EXT_ADVERTISING=y
CONFIG_CHIP_BLE_ADVERTISING_DURATION=60

# The DK library drives the buttons and LEDs of a Nordic development kit. We have neither: one
# button, no status LEDs, and that button already belongs to Zephyr's gpio-keys + input-longpress
# drivers (src/input/button.cpp). Two owners on one pin is not a style question -- the DK library
# takes raw GPIO callbacks and *disables the pin interrupt* while it debounces, which is the same
# interrupt gpio-keys is using. Off. Nrf::Board and the LED widgets are wholly #ifdef'd on this,
# so they degrade to no-ops (and the sample's "LED index out of the range" boot error goes away).
CONFIG_DK_LIBRARY=n

# Bluetooth Low Energy configuration. This name is the only one actually on the air during
# BLE commissioning -- the Matter commissionable payload carries no device name (see
# CHIP_DEVICE_CONFIG_ENABLE_COMMISSIONABLE_DEVICE_NAME in chip_project_config.h), which is
# why a controller shows a generic "Matter Accessory" until it can read Basic Information.
CONFIG_BT_DEVICE_NAME="AirInk"
CONFIG_BT_DEVICE_NAME_MAX=18

# What the Zephyr/NCS boot banner calls us. Left unset it is literally "My Application" -- the
# NCS default -- which is what the console has been printing all along. (The line app.cpp prints
# right after is the useful one: it carries the version, the build variant and the build date.)
CONFIG_NCS_APPLICATION_BOOT_BANNER_STRING="AirInk"

# (Device power management -- CONFIG_PM_DEVICE / CONFIG_PM_DEVICE_RUNTIME -- is a board fact and
# lives in conf/airink_hw.conf with the drivers it applies to. It used to be repeated here.)

# How often the radio asks the router "anything for me?" -- measured at 11 mA a poll, and ~6 % of the
# device's energy budget.
#
# We are a LIT ICD on paper (LIT_SUPPORT / CHECK_IN / UAT are all on) and CHIP_ICD_SLOW_POLL_INTERVAL
# is 300 s -- but that never takes effect: the spec requires a LIT device to operate in *SIT* mode
# until some client has registered itself via the ICD Management cluster, and nothing does (Home
# Assistant does not; the log says "ICD: not present" on every announcement). In SIT mode the poll is
# capped at this limit, so this limit -- not the 300 s -- is what the radio actually does.
#
# The sample ships 5 s. The spec's ceiling, and NCS's own default, is 15 s. Taking it cuts the polls
# by 3x (~8 % of the budget, ~+10 days on a 1000 mAh cell). What it costs is reachability latency: a
# command from a controller can now sit up to 15 s before we fetch it. For a sensor that only ever
# reports, that is not a cost at all.
CONFIG_CHIP_ICD_SIT_SLOW_POLL_LIMIT=15000

# Other settings
CONFIG_THREAD_NAME=y
CONFIG_MPU_STACK_GUARD=y
CONFIG_RESET_ON_FATAL_ERROR=n
# Shell off for the bring-up (saves flash; RAM barely).
CONFIG_CHIP_LIB_SHELL=n

# Reduce application size
CONFIG_USE_SEGGER_RTT=n

# Built-in example attestation provider: it ships a complete, self-consistent set --
# DAC (FFF1/8000), PAI (FFF1), and a CD (kCdForAllExamples, covering PID 0x8000..) -- all
# hardcoded, no factory-data partition, no chip-cert host tool needed. The device's PID
# must be 0x8000 to match the example DAC (set below); the CD covers it. With HA's
# enable_test_net_dcl=true the test certs are trusted. Passcode stays custom (below).
CONFIG_CHIP_FACTORY_DATA_NONE=y
CONFIG_CHIP_DEVICE_SPAKE2_PASSCODE=528722
# The SPAKE2+ verifier is a STATIC Kconfig default -- it is NOT recomputed when the
# passcode changes. Its default belongs to passcode 20202021, so a custom passcode with
# the stock verifier makes the device advertise 528722 while proving knowledge of
# 20202021: the commissioner's Pake2 check fails and it drops BLE mid-PASE.
# Generated for passcode 528722 / this salt / 1000 iterations with
#   scripts/tools/spake2p/spake2p.py gen-verifier -p 528722 -s <salt> -i 1000
CONFIG_CHIP_DEVICE_SPAKE2_TEST_VERIFIER="LdCcPszn0rvDj59TPG1d2kQstzG8hR1Ty0PvpWUYgeUEPahM+o4wma7TlCWuMm8Z4blyJEp/VQdDBcCTW8c3JbFoMFvieDwXAbMtL/i3GSFf/d42EjivkDMMpDw2K9Fohg=="

# (OTA requestor is turned off at the sysbuild layer: SB_CONFIG_MATTER_OTA=n. It's
# injected via .config.sysbuild, which is merged AFTER prj.conf, so a prj.conf override
# here would be ignored -- the switch has to live in sysbuild.conf.)

# Matter has its own bootloader choice, separate from the sysbuild one, defaulting to
# CHIP_BOOTLOADER_MCUBOOT which hard-selects IMG_MANAGER (whose STREAM_FLASH dependency
# is now off). Pick NONE -- we have no MCUboot.
CONFIG_CHIP_BOOTLOADER_NONE=y

# (The image is bounded by the code partition -- CONFIG_FLASH_LOAD_SIZE -- in conf/airink_hw.conf,
# next to the flash map it mirrors. It used to live here, back when only this build had a map.)

# NFC onboarding pulls in the NFC T2T nrfxlib, but the promicro board doesn't enable the
# nrfx NFCT driver (the DK does) -> undefined nrfx_nfct_* at link. We commission over BLE
# with the QR / manual code, so drop NFC onboarding.
CONFIG_CHIP_NFC_ONBOARDING_PAYLOAD=n

# The board's drivers -- SCD41, battery ADC, e-paper, LVGL, the button, the uart0 console, the
# UF2 output -- are not repeated here. They live in conf/airink_hw.conf, shared with the standalone
# firmware and pulled in by CMakeLists.txt. Below is only what this build decides differently.
#
# The one exception is the LVGL pool: it is a tuning knob, not a board fact, and this build cannot
# afford the standalone one's 48 KB.
#
# All views are built once and kept resident, and glyph draw buffers (b612_48 is ~2 KB) come out of
# the pool during a render. Running it dry is an MPU fault in lv_draw_label, not a graceful failure
# -- and it is not hypothetical: 24576 was enough until the pairing view arrived, whose QR draw
# buffer alone is 5004 B (ui::log_pool() prints every view's cost at boot). That left ~7.7 KB, which
# fragmentation turned into "not enough contiguous space for a glyph" and the board panicked on the
# boot splash. Read those lines before adding a view or a font; do not guess.
CONFIG_LV_Z_MEM_POOL_SIZE=32768

# --- Stacks. RAM is what this build is short of; every kilobyte here is one the UI cannot have.
# main() no longer renders anything -- it only runs the CHIP task queue (AppTask::StartApp), and
# the 400x300 render with its 48 px glyph rasterisation moved to AirInk's own thread, which is
# sized for it in app_task.cpp. The sample's 6 KB was for a main that did the work.
CONFIG_MAIN_STACK_SIZE=3072
# The CHIP event loop. Our cluster writes take the stack lock from AirInk's thread rather than
# running here, so this carries Matter's own work only.
CONFIG_CHIP_TASK_STACK_SIZE=6144

# CHIP heap. The 10 KB default cannot build the NetworkCommissioning ScanNetworks
# response (cluster 0x0031 cmd 0x0000): the device returns NO_MEMORY ("Adding response
# failed: b"), the commissioner stalls, the fail-safe expires and the fabric is rolled
# back. Home Assistant issues ScanNetworks during commissioning (the phone framework does
# not, which is why that path used to get through). It looks like an obvious 8 KB to reclaim now
# that RAM is tight -- it is not.
CONFIG_CHIP_MALLOC_SYS_HEAP_SIZE=40960
```

## power.conf
```kconfig
# The measurement build. Same firmware, no voice.
#
#   west build -b promicro_nrf52840/nrf52840 apps/matter -- -Dmatter_AIRINK_POWER=y
#
# You cannot measure this device while it is talking. A live console UARTE holds the HFCLK on, and
# that alone is ~1 mA against a ~60 uA idle floor -- so a measurement of the normal build is mostly
# a measurement of the log, and the radio it was supposed to weigh disappears into the noise. The
# Matter build is the loud one: CHIP logs every message it sends.
#
# Turning the logging subsystem off is also what hands the console back to app.cpp, which then
# powers the UART down while it sleeps (see the #ifndef CONFIG_LOG there) -- the same trick the
# standalone firmware has always used, and the reason its idle floor is 60 uA rather than 1 mA.
#
# What you give up: everything it would have told you. Flash it, measure it, flash the normal one
# back.
#
# CONSOLE/UART_CONSOLE/SERIAL deliberately stay ON. The UART device has to exist for app.cpp to
# suspend it and for the devicetree's zephyr,console node to resolve -- it is instantiated and then
# put to sleep, which is precisely the point. With nothing left to write to it, that costs nothing.

CONFIG_LOG=n
CONFIG_PRINTK=n
```

## boards/promicro_nrf52840_nrf52840.overlay
```dts
/*
 * The Matter build's devicetree: AirInk's hardware -- the same SCD41, button, e-paper, battery
 * divider and uart0 console as the standalone firmware, and the same flash map.
 *
 * All of it comes from the shared .dtsi. This file used to carry the partition map as the one thing
 * that differed between the builds. It no longer differs: both run on the same board on top of the
 * same bootloader, so the map moved to dts/airink_flash.dtsi (pulled in by airink_hw.dtsi), where
 * both builds get it and where a build cannot forget to ask for it. See that file for the layout,
 * and for why the board's stock map would eat the bootloader.
 */

#include "../../../dts/airink_hw.dtsi"
```

## src/app_task.cpp
```c
/*
 * Copyright (c) 2025 Nordic Semiconductor ASA
 *
 * SPDX-License-Identifier: LicenseRef-Nordic-5-Clause
 */

#include "app_task.h"

#include "app/matter_init.h"
#include "app/matter_event_handler.h"
#include "app/task_executor.h"
#include "board/board.h"
#include "clusters/identify.h"
#include "lib/core/CHIPError.h"

#include "app.hpp"
#include "net.hpp"

#include <app-common/zap-generated/attributes/Accessors.h>
#include <app/clusters/air-quality-server/air-quality-server.h>
#include <app/clusters/concentration-measurement-server/concentration-measurement-server.h>
#include <app/clusters/power-source-server/power-source-server.h>
#include <app/clusters/unit-localization-server/unit-localization-server.h>
#include <app/server/Server.h>
#include <openthread/thread.h>
#include <platform/ThreadStackManager.h>
#include <setup_payload/OnboardingCodesUtil.h>
#include <setup_payload/QRCodeSetupPayloadGenerator.h>

#include <zephyr/kernel.h>
#include <zephyr/logging/log.h>

LOG_MODULE_DECLARE(app, CONFIG_CHIP_APP_LOG_LEVEL);

using namespace ::chip;
using namespace ::chip::app; /* NB: this makes a bare `app::` ambiguous with AirInk's own
					  namespace -- reach for the latter as ::app:: */
using namespace ::chip::DeviceLayer;
using namespace ::chip::app::Clusters;

namespace
{
/* Endpoint map -- see src/default_zap/airink.zap. One physical sensor, one endpoint: the Air
 * Quality Sensor device type may carry temperature and humidity alongside the CO2 clusters, so
 * everything the SCD41 measures lives on endpoint 1. (Splitting it into a temperature, humidity
 * and air quality endpoint also works, but each device type mandates its own Identify cluster,
 * and a controller then shows three "Identify" entities for one device.) */
constexpr EndpointId kPowerSourceEndpointId = 0; /* root node */
constexpr EndpointId kSensorEndpointId = 1;

/* The battery powers the whole node. */
EndpointId sPoweredEndpoints[] = { 0, 1 };

Nrf::Matter::IdentifyCluster sIdentifyCluster(kSensorEndpointId);

/* Unlike temperature and humidity, the air quality and concentration clusters are not backed
 * by the ember attribute store -- they are served by these AttributeAccessInterface instances,
 * which is why the ZAP marks their attributes "External". The concentration template flags are
 * <Numeric, Level, MediumLevel, CriticalLevel, Peak, Average>: we report a numeric ppm value
 * and nothing else, and the ZAP's attribute list must match that exactly. */
AirQuality::Instance sAirQuality(kSensorEndpointId,
				 BitMask<AirQuality::Feature, uint32_t>(AirQuality::Feature::kModerate,
									AirQuality::Feature::kFair,
									AirQuality::Feature::kVeryPoor,
									AirQuality::Feature::kExtremelyPoor));

ConcentrationMeasurement::Instance<true, false, false, false, false, false>
	sCo2(kSensorEndpointId, CarbonDioxideConcentrationMeasurement::Id,
	     ConcentrationMeasurement::MeasurementMediumEnum::kAir,
	     ConcentrationMeasurement::MeasurementUnitEnum::kPpm);

/* What the SCD41 can OUTPUT (0..40000 ppm) -- NOT its accuracy band (400..5000). The SDK enforces
 * Min/MaxMeasuredValue: SetMeasuredValue() silently stores NOTHING outside them
 * (concentration-measurement-server.h:366), so the accuracy band here froze the HA number at 5000
 * in exactly the bedroom-overnight case a person bought a CO2 monitor for. */
constexpr float kCo2MinPpm = 0.0f;
constexpr float kCo2MaxPpm = 40000.0f;

/* AirInk's own thread. It renders a 400x300 mono frame with 48 px fonts and blocks ~5 s in a
 * CO2 single-shot, so it gets the big stack -- and it gets it here rather than on the CHIP event
 * loop, which OpenThread needs responsive. Priority below the cooperative CHIP/OT threads. */
K_THREAD_STACK_DEFINE(sAirInkStack, 8192);
k_thread sAirInkThread;

/* CO2 as a proxy for air quality. The thresholds are the usual indoor-air guidance (Pettenkofer's
 * 1000 ppm is the "still fine" line; 2000 ppm is where concentration measurably suffers). */
AirQuality::AirQualityEnum AirQualityFromCo2(uint16_t ppm)
{
	if (ppm < 800) {
		return AirQuality::AirQualityEnum::kGood;
	}
	if (ppm < 1000) {
		return AirQuality::AirQualityEnum::kFair;
	}
	if (ppm < 1400) {
		return AirQuality::AirQualityEnum::kModerate;
	}
	if (ppm < 2000) {
		return AirQuality::AirQualityEnum::kPoor;
	}
	if (ppm < 5000) {
		return AirQuality::AirQualityEnum::kVeryPoor;
	}
	return AirQuality::AirQualityEnum::kExtremelyPoor;
}

/* Both hooks run on AirInk's thread, so they take the CHIP stack lock -- the documented way to
 * touch cluster attributes from outside the event loop. Holding it across four setters keeps the
 * reading self-consistent for anyone reading it at that moment; none of them block. */
void PublishReading(const Scd41Reading &r)
{
	PlatformMgr().LockChipStack();
	TemperatureMeasurement::Attributes::MeasuredValue::Set(kSensorEndpointId,
							       static_cast<int16_t>(r.temp_x100));
	RelativeHumidityMeasurement::Attributes::MeasuredValue::Set(kSensorEndpointId, r.hum_x100);
	/* Checked, because it can refuse: a value outside Min/MaxMeasuredValue is dropped in silence, and
	 * a CO2 number that quietly stops moving is worse than one that is missing. */
	const CHIP_ERROR co2Err =
		sCo2.SetMeasuredValue(DataModel::Nullable<float>(static_cast<float>(r.co2_ppm)));
	if (co2Err != CHIP_NO_ERROR) {
		LOG_ERR("CO2 %u ppm was not published (%s)", r.co2_ppm, co2Err.AsString());
	}
	sAirQuality.UpdateAirQuality(AirQualityFromCo2(r.co2_ppm));
	PlatformMgr().UnlockChipStack();
}

void PublishBattery(const battery::State &bat)
{
	PlatformMgr().LockChipStack();
	/* The cell terminal voltage, in mV (batVoltage is int32u mV). Reads the true cell even on USB:
	 * the divider sits on BAT+, not the supply rail. */
	PowerSource::Attributes::BatVoltage::Set(kPowerSourceEndpointId, bat.mv);
	/* Matter counts the battery in half percent. */
	PowerSource::Attributes::BatPercentRemaining::Set(kPowerSourceEndpointId,
							  static_cast<uint8_t>(bat.pct * 2));
	PowerSource::Attributes::BatChargeState::Set(kPowerSourceEndpointId,
						     bat.charging ? PowerSource::BatChargeStateEnum::kIsCharging
								  : PowerSource::BatChargeStateEnum::kIsNotCharging);
	PowerSource::Attributes::BatChargeLevel::Set(kPowerSourceEndpointId,
						     bat.low ? PowerSource::BatChargeLevelEnum::kCritical
							     : PowerSource::BatChargeLevelEnum::kOk);

	PlatformMgr().UnlockChipStack();
}

/* Runs on the CHIP thread; only records the state, the loop paints it. Thread connectivity is the
 * ONE event the panel cares about -- it gates the signal bars. (BLE advertising was reported too,
 * for a status token deleted long before its enum was; nothing drew it, now nothing reports it.) */
void MatterEventHandler(const ChipDeviceEvent *event, intptr_t)
{
	if (event->Type == DeviceEventType::kThreadConnectivityChange) {
		::net::set_thread_connected(event->ThreadConnectivityChange.Result ==
					    kConnectivity_Established);
	}
}

/* Fabric membership, event-driven: committed and removed are the only two edges, and the fabric
 * table calls both on the CHIP thread. (There is no DeviceEventType for a removal in this SDK --
 * this delegate is what exists instead. Before it, the flag was refreshed as a ride-along in the
 * battery hook, and the onboarding flow depended on a side effect of a function named "battery".) */
class FabricDelegate : public chip::FabricTable::Delegate {
	void OnFabricCommitted(const chip::FabricTable &table, FabricIndex) override
	{
		::net::set_commissioned(table.FabricCount() > 0);
	}
	void OnFabricRemoved(const chip::FabricTable &table, FabricIndex) override
	{
		::net::set_commissioned(table.FabricCount() > 0);
	}
};
FabricDelegate sFabricDelegate;

/* The onboarding codes, fetched once from CHIP. Static because net::set_pairing_codes() does not
 * copy them and the UI holds the pointers for the life of the device. */
char sQrCode[chip::QRCodeBasicSetupPayloadGenerator::kMaxQRCodeBase38RepresentationLength + 1];
char sManualCode[chip::kManualSetupLongCodeCharLength + 1];
char sManualCodePretty[sizeof(sManualCode) + 2]; /* room for the two dashes */

/* Group the manual code 4-3-4 as every controller UI does -- eleven bare digits are read wrong.
 * Only the 11-digit short code; anything unexpected passes through unmangled. */
const char *GroupManualCode(const char *digits)
{
	if (strlen(digits) != 11) {
		return digits;
	}
	snprintf(sManualCodePretty, sizeof(sManualCodePretty), "%.4s-%.3s-%.4s", digits, digits + 4,
		 digits + 7);
	return sManualCodePretty;
}

/* What a controller needs to find and authenticate this device -- the same payload the sample
 * prints to the log at boot, but printed on the e-paper, where the user actually is. It does not
 * change over the device's life, so read it once and hand it to the UI. */
void FetchOnboardingCodes()
{
	chip::MutableCharSpan qr(sQrCode);
	chip::MutableCharSpan manual(sManualCode);
	const chip::RendezvousInformationFlags rendezvous(chip::RendezvousInformationFlag::kBLE);

	if (GetQRCode(qr, rendezvous) != CHIP_NO_ERROR ||
	    GetManualPairingCode(manual, rendezvous) != CHIP_NO_ERROR) {
		LOG_ERR("Could not read the onboarding codes; no pairing screen");
		return;
	}

	::net::set_pairing_codes(sQrCode, GroupManualCode(sManualCode));
}

/* How long the radio listens after the user asks for the code: enough to fetch a phone, not the
 * boot window's full hour (CONFIG_CHIP_BLE_ADVERTISING_DURATION) -- that is right for a factory-new
 * device, too generous for a gesture. */
constexpr auto kPanelPairingWindow = System::Clock::Seconds32(10 * 60);

/* The code is on the panel: start listening, or the QR is a dead letter once the boot hour is over.
 * The two guards mirror Nordic's Board::StartBLEAdvertisement: a commissioned device must not
 * re-open (a second commissioner could join uninvited), and an already-advertising one must not be
 * restarted -- that would drop a PASE session seconds from completing. The second guard also means
 * a device inside its boot hour keeps the hour. Runs on AirInk's thread; takes the stack lock. */
void OpenPairingWindow()
{
	PlatformMgr().LockChipStack();

	if (Server::GetInstance().GetFabricTable().FabricCount() != 0) {
		LOG_INF("Already commissioned; not re-opening the window");
	} else if (ConnectivityMgr().IsBLEAdvertisingEnabled()) {
		LOG_INF("Commissioning window already open");
	} else if (Server::GetInstance().GetCommissioningWindowManager().OpenBasicCommissioningWindow(
			   kPanelPairingWindow) != CHIP_NO_ERROR) {
		LOG_ERR("Could not open the commissioning window");
	} else {
		LOG_INF("Commissioning window opened from the panel for %u s",
			kPanelPairingWindow.count());
	}

	PlatformMgr().UnlockChipStack();
}

/* The user dismissed the QR screen: cut the window down to ten minutes (for the boot autostart
 * hour, that is a real cut; for a menu-opened window, a no-op). CHIP has no "shorten", so this
 * closes and re-opens -- safe precisely here, because nobody presses the button mid-scan;
 * OpenPairingWindow deliberately does NOT restart an open window, since there it really could
 * interrupt a PASE session. */
void ShortenPairingWindow()
{
	PlatformMgr().LockChipStack();

	auto &window = Server::GetInstance().GetCommissioningWindowManager();
	if (Server::GetInstance().GetFabricTable().FabricCount() != 0) {
		LOG_INF("Commissioned in the meantime; leaving the window alone");
	} else {
		window.CloseCommissioningWindow();
		if (window.OpenBasicCommissioningWindow(kPanelPairingWindow) != CHIP_NO_ERROR) {
			LOG_ERR("Could not re-open the commissioning window");
		} else {
			LOG_INF("Onboarding dismissed; window now closes in %u s",
				kPanelPairingWindow.count());
		}
	}

	PlatformMgr().UnlockChipStack();
}

/* The user held the button on a confirmation screen that said what this does. CHIP wipes the
 * fabrics and reboots; it schedules the work rather than doing it here, because we are on AirInk's
 * thread and the storage belongs to the CHIP one. */
void FactoryReset()
{
	LOG_INF("Factory reset requested from the panel");
	Server::GetInstance().ScheduleFactoryReset();
}

/* Unit Localization (0x002D, root node): the unit the PANEL displays -- the temperature itself
 * stays centi-Celsius on the wire, always. The SDK's server is a closed singleton with neither
 * delegate nor callback, so traffic goes both ways by hand: pushed out here, polled back in by
 * net::poll(). */
ui::TempUnit FromMatter(UnitLocalization::TempUnitEnum u)
{
	return u == UnitLocalization::TempUnitEnum::kFahrenheit ? ui::TempUnit::Fahrenheit
							       : ui::TempUnit::Celsius;
}

void PublishUnit(ui::TempUnit u)
{
	const auto unit = (u == ui::TempUnit::Fahrenheit) ? UnitLocalization::TempUnitEnum::kFahrenheit
							  : UnitLocalization::TempUnitEnum::kCelsius;

	PlatformMgr().LockChipStack();
	const CHIP_ERROR err = UnitLocalization::UnitLocalizationServer::Instance().SetTemperatureUnit(unit);
	PlatformMgr().UnlockChipStack();

	if (err != CHIP_NO_ERROR) {
		LOG_ERR("Could not publish the temperature unit (%s)", err.AsString());
	}
}

bool UnitFromNetwork(ui::TempUnit *out)
{
	PlatformMgr().LockChipStack();
	*out = FromMatter(UnitLocalization::UnitLocalizationServer::Instance().GetTemperatureUnit());
	PlatformMgr().UnlockChipStack();
	return true;
}

/* How well the parent router hears us. The AVERAGE, not the last packet (a single frame is noise);
 * OpenThread already keeps it, so this is a read, not a measurement. Fails, correctly, whenever
 * there is no parent: not joined, or a router itself. */
bool LinkRssi(int8_t *out)
{
	ThreadStackMgr().LockThreadStack();
	const otError err = otThreadGetParentAverageRssi(ThreadStackMgrImpl().OTInstance(), out);
	ThreadStackMgr().UnlockThreadStack();

	return err == OT_ERROR_NONE && *out != OT_RADIO_RSSI_INVALID;
}

void AirInkThread(void *, void *, void *)
{
	const ::net::Hooks hooks = {
		.reading = PublishReading,
		.battery = PublishBattery,
		.factory_reset = FactoryReset,
		.pairing_open = OpenPairingWindow,
		.pairing_dismissed = ShortenPairingWindow,
		.publish_unit = PublishUnit,
		.unit_from_network = UnitFromNetwork,
		.link_rssi = LinkRssi,
	};
	::net::set_hooks(hooks);
	::app::run("Matter over Thread"); /* never returns */
}

} /* namespace */

CHIP_ERROR AppTask::Init()
{
	ReturnErrorOnFailure(Nrf::Matter::PrepareServer());
	ReturnErrorOnFailure(Nrf::Matter::RegisterEventHandler(MatterEventHandler, 0));
	ReturnErrorOnFailure(sIdentifyCluster.Init());
	ReturnErrorOnFailure(Nrf::Matter::StartServer());

	/* Only now. These three reach into the ember endpoint tables, which do not exist until
	 * Server::Init() has run emberAfEndpointConfigure() -- i.e. until StartServer() returns.
	 * AirQuality::Instance::Init() asserts on it with VerifyOrDie (a boot-time abort), the
	 * concentration instance merely returns an error and would then silently never publish.
	 * The event loop is live by now, so take the stack lock. */
	CHIP_ERROR err = CHIP_NO_ERROR;
	PlatformMgr().LockChipStack();
	err = sAirQuality.Init();
	if (err == CHIP_NO_ERROR) {
		err = sCo2.Init();
	}
	if (err == CHIP_NO_ERROR) {
		/* Static facts about the source: the SCD41's range, and the endpoints it powers. */
		sCo2.SetMinMeasuredValue(DataModel::Nullable<float>(kCo2MinPpm));
		sCo2.SetMaxMeasuredValue(DataModel::Nullable<float>(kCo2MaxPpm));
		PowerSourceServer::Instance().SetEndpointList(kPowerSourceEndpointId,
							      Span<EndpointId>(sPoweredEndpoints));
	}
	PlatformMgr().UnlockChipStack();

	return err;
}

CHIP_ERROR AppTask::StartApp()
{
	ReturnErrorOnFailure(Init());

	/* Before the thread starts: app::run() reads the codes when it builds the UI, and whether
	 * there are any is what decides that the menu has a Matter row at all. The fabric table has
	 * been loaded from NVS by now, so the seed below is the state a reboot comes back to; the
	 * delegate keeps it current from there. */
	FetchOnboardingCodes();
	Server::GetInstance().GetFabricTable().AddFabricDelegate(&sFabricDelegate);
	::net::set_commissioned(Server::GetInstance().GetFabricTable().FabricCount() > 0);

	k_thread_create(&sAirInkThread, sAirInkStack, K_THREAD_STACK_SIZEOF(sAirInkStack), AirInkThread,
			nullptr, nullptr, nullptr, K_PRIO_PREEMPT(10), 0, K_NO_WAIT);
	k_thread_name_set(&sAirInkThread, "airink");

	while (true) {
		Nrf::DispatchNextTask();
	}

	return CHIP_NO_ERROR;
}
```

## src/app_task.h
```c
/*
 * Copyright (c) 2025 Nordic Semiconductor ASA
 *
 * SPDX-License-Identifier: LicenseRef-Nordic-5-Clause
 */

#pragma once

#include <platform/CHIPDeviceLayer.h>

/** Brings up Matter, then hands the device itself to AirInk.
 *
 * StartApp() runs the CHIP task queue on the main thread forever. Everything AirInk does --
 * the panel, the SCD41, the button, the menu -- runs on a thread of its own (app::run(), see
 * src/app.hpp), because a full CO2 read blocks for ~5 s and an e-paper refresh for ~2 s, and
 * neither may sit on the CHIP event loop while OpenThread waits to poll its parent.
 *
 * Direction of travel: AirInk measures, and hands each reading to Matter. Matter never reaches
 * back into the UI -- the network state is left where the loop picks it up (net::set_thread_connected()).
 */
class AppTask {
public:
	static AppTask &Instance()
	{
		static AppTask sAppTask;
		return sAppTask;
	};

	CHIP_ERROR StartApp();

private:
	CHIP_ERROR Init();
};
```
